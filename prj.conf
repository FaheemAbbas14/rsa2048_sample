## CMakeLists.txt
```
cmake_minimum_required(VERSION 3.20.0)
find_package(Zephyr REQUIRED HINTS $ENV{ZEPHYR_BASE})
project(rsa2048_sample)

target_sources(app PRIVATE
	src/main.c
	src/rsa_key_manager.c
	src/lfs_key_store.c
)
```

## prj.conf
```kconfig
CONFIG_SERIAL=y
CONFIG_CONSOLE=y
CONFIG_PRINTK=y
CONFIG_LOG=y
CONFIG_LOG_DEFAULT_LEVEL=3

CONFIG_CRYPTO=y
CONFIG_NRF_SECURITY=y
CONFIG_MBEDTLS=y
CONFIG_MBEDTLS_ENABLE_HEAP=y
CONFIG_MBEDTLS_HEAP_SIZE=65536

CONFIG_FLASH=y
CONFIG_FLASH_MAP=y
CONFIG_FILE_SYSTEM=y
CONFIG_FILE_SYSTEM_LITTLEFS=y

CONFIG_PSA_CRYPTO_DRIVER_OBERON=y
CONFIG_PSA_CRYPTO_DRIVER_CC3XX=y

CONFIG_MBEDTLS_PSA_CRYPTO_C=y

CONFIG_PSA_WANT_KEY_TYPE_RSA_KEY_PAIR_GENERATE=y
CONFIG_PSA_WANT_KEY_TYPE_RSA_KEY_PAIR_DERIVE=y
CONFIG_PSA_WANT_KEY_TYPE_RSA_KEY_PAIR_IMPORT=y
CONFIG_PSA_WANT_KEY_TYPE_RSA_KEY_PAIR_EXPORT=y
CONFIG_PSA_WANT_KEY_TYPE_RSA_PUBLIC_KEY=y
CONFIG_PSA_WANT_ALG_RSA_PKCS1V15_SIGN=y
CONFIG_PSA_WANT_ALG_RSA_PKCS1V15_CRYPT=y
CONFIG_PSA_WANT_ALG_SHA_256=y
CONFIG_PSA_WANT_RSA_KEY_SIZE_2048=y
CONFIG_PSA_WANT_RSA_KEY_SIZE_1024=n
CONFIG_MAIN_STACK_SIZE=12288
CONFIG_HEAP_MEM_POOL_SIZE=32768
```

## boards/nrf5340dk_nrf5340_cpuapp.overlay
```dts
/ {
	fstab {
		compatible = "zephyr,fstab";

		lfs1: lfs1 {
			compatible = "zephyr,fstab,littlefs";
			mount-point = "/lfs";
			partition = <&storage_partition>;
			automount;
			read-size = <16>;
			prog-size = <16>;
			cache-size = <64>;
			lookahead-size = <32>;
			block-cycles = <512>;
		};
	};
};
```

## src/main.c
```c
#include <zephyr/kernel.h>
#include <zephyr/sys/printk.h>

#include <psa/crypto.h>

#include <string.h>

#include "rsa_key_manager.h"

/* Print PSA errors with readable status name from rsa_key_manager. */
static void print_psa_error(const char *label, psa_status_t status)
{
	printk("%s failed: %d (%s)\n", label, status, rsa_key_manager_status_string(status));
}

int main(void)
{
	/* Demo message that will be encrypted/decrypted with RSA. */
	psa_status_t status;
	const unsigned char plaintext[] = "Hello from nRF5340 RSA";
	/* RSA ciphertext size is RSA_KEY_SIZE_BITS / 8 bytes. */
	unsigned char ciphertext[RSA_KEY_SIZE_BITS / 8];
	unsigned char decrypted[128];
	size_t ciphertext_len = 0;
	size_t decrypted_len = 0;
	psa_key_id_t key_id = PSA_KEY_ID_NULL;

	printk("\n=== RSA Encrypt/Decrypt ===\n");

	status = psa_crypto_init();
	if (status != PSA_SUCCESS) {
		print_psa_error("psa_crypto_init", status);
		goto cleanup;
	}

	/* Load persisted key from LittleFS, or generate + store once. */
	status = rsa_key_manager_load_or_generate(&key_id);
	if (status != PSA_SUCCESS) {
		print_psa_error("rsa_key_manager_load_or_generate", status);
		goto cleanup;
	}

	printk("RSA key pair ready: %d bits\n", RSA_KEY_SIZE_BITS);

	status = rsa_key_manager_encrypt(key_id,
					 plaintext,
					 sizeof(plaintext) - 1,
					 ciphertext,
					 sizeof(ciphertext),
					 &ciphertext_len);
	if (status != PSA_SUCCESS) {
		print_psa_error("rsa_key_manager_encrypt", status);
		goto cleanup;
	}

	printk("Encryption success. Ciphertext length: %u bytes\n", (unsigned int)ciphertext_len);

	status = rsa_key_manager_decrypt(key_id,
					 ciphertext,
					 ciphertext_len,
					 decrypted,
					 sizeof(decrypted) - 1,
					 &decrypted_len);
	if (status != PSA_SUCCESS) {
		print_psa_error("rsa_key_manager_decrypt", status);
		goto cleanup;
	}

	decrypted[decrypted_len] = '\0';

	printk("Decryption success. Plaintext: %s\n", decrypted);

	if (decrypted_len == sizeof(plaintext) - 1 &&
	    memcmp(decrypted, plaintext, decrypted_len) == 0) {
		printk("Result: PASS (decrypted text matches original)\n");
	} else {
		printk("Result: FAIL (decrypted text mismatch)\n");
	}

cleanup:
	/* Key handle is volatile and should be destroyed before exit. */
	if (key_id != PSA_KEY_ID_NULL) {
		(void)psa_destroy_key(key_id);
	}

	return 0;
}
```

## src/lfs_key_store.c
```c
#include "lfs_key_store.h"

#include <zephyr/fs/fs.h>

#include <errno.h>

/* Create/truncate file and write entire payload. */
int lfs_key_store_write(const char *path, const uint8_t *data, size_t data_len)
{
	struct fs_file_t file;
	ssize_t written;
	int ret;

	fs_file_t_init(&file);

	ret = fs_open(&file, path, FS_O_CREATE | FS_O_WRITE | FS_O_TRUNC);
	if (ret < 0) {
		return ret;
	}

	written = fs_write(&file, data, data_len);
	if (written != (ssize_t)data_len) {
		(void)fs_close(&file);
		return -EIO;
	}

	ret = fs_close(&file);
	if (ret < 0) {
		return ret;
	}

	return 0;
}

/*
 * Read up to data_size bytes from file.
 * If file is larger than buffer, return -EFBIG to avoid partial silent reads.
 */
int lfs_key_store_read(const char *path, uint8_t *data, size_t data_size, size_t *data_len)
{
	struct fs_file_t file;
	ssize_t read_len;
	size_t total = 0;
	int ret;

	*data_len = 0;
	fs_file_t_init(&file);

	ret = fs_open(&file, path, FS_O_READ);
	if (ret < 0) {
		return ret;
	}

	while (total < data_size) {
		read_len = fs_read(&file, data + total, data_size - total);
		if (read_len < 0) {
			(void)fs_close(&file);
			return (int)read_len;
		}

		if (read_len == 0) {
			break;
		}

		total += (size_t)read_len;
	}

	if (total == data_size) {
		uint8_t extra_byte;

		read_len = fs_read(&file, &extra_byte, 1);
		if (read_len < 0) {
			(void)fs_close(&file);
			return (int)read_len;
		}

		if (read_len > 0) {
			(void)fs_close(&file);
			return -EFBIG;
		}
	}

	ret = fs_close(&file);
	if (ret < 0) {
		return ret;
	}

	*data_len = total;
	return 0;
}
```

## src/lfs_key_store.h
```c
#ifndef LFS_KEY_STORE_H
#define LFS_KEY_STORE_H

#include <stddef.h>
#include <stdint.h>

/* Write binary data to a LittleFS file path. Returns 0 or negative errno. */
int lfs_key_store_write(const char *path, const uint8_t *data, size_t data_len);

/* Read file bytes into buffer. Returns 0 or negative errno and fills data_len. */
int lfs_key_store_read(const char *path, uint8_t *data, size_t data_size, size_t *data_len);

#endif
```

## src/rsa_key_manager.c
```c
#include "rsa_key_manager.h"

#include "lfs_key_store.h"

#include <zephyr/sys/printk.h>

#include <errno.h>
#include <string.h>

#define KEY_FILE_PATH "/lfs/rsa_keypair.bin"
#define KEY_FILE_MAGIC 0x52534133U
#define KEY_BLOB_MAX_SIZE 4096

/*
 * File format stored in LittleFS:
 * [key_file_header][raw PSA-exported private key blob]
 */
struct key_file_header {
	uint32_t magic;
	uint32_t key_blob_len;
};

/* Convert common PSA status codes to readable strings for logs. */
const char *rsa_key_manager_status_string(psa_status_t status)
{
	switch (status) {
	case PSA_SUCCESS:
		return "PSA_SUCCESS";
	case PSA_ERROR_NOT_SUPPORTED:
		return "PSA_ERROR_NOT_SUPPORTED";
	case PSA_ERROR_INVALID_ARGUMENT:
		return "PSA_ERROR_INVALID_ARGUMENT";
	case PSA_ERROR_NOT_PERMITTED:
		return "PSA_ERROR_NOT_PERMITTED";
	case PSA_ERROR_BAD_STATE:
		return "PSA_ERROR_BAD_STATE";
	case PSA_ERROR_BUFFER_TOO_SMALL:
		return "PSA_ERROR_BUFFER_TOO_SMALL";
	case PSA_ERROR_INSUFFICIENT_MEMORY:
		return "PSA_ERROR_INSUFFICIENT_MEMORY";
	case PSA_ERROR_INSUFFICIENT_STORAGE:
		return "PSA_ERROR_INSUFFICIENT_STORAGE";
	case PSA_ERROR_DOES_NOT_EXIST:
		return "PSA_ERROR_DOES_NOT_EXIST";
	case PSA_ERROR_GENERIC_ERROR:
		return "PSA_ERROR_GENERIC_ERROR";
	default:
		return "PSA_ERROR_UNKNOWN";
	}
}

/*
 * Persist a private key blob in LittleFS using a tiny header
 * so we can validate content on reboot.
 */
static int write_key_blob_to_file(const uint8_t *key_blob, size_t key_blob_len)
{
	uint8_t file_data[sizeof(struct key_file_header) + KEY_BLOB_MAX_SIZE];
	struct key_file_header header = {
		.magic = KEY_FILE_MAGIC,
		.key_blob_len = (uint32_t)key_blob_len,
	};

	if (key_blob_len > KEY_BLOB_MAX_SIZE) {
		return -EINVAL;
	}

	(void)memcpy(file_data, &header, sizeof(header));
	(void)memcpy(file_data + sizeof(header), key_blob, key_blob_len);

	return lfs_key_store_write(KEY_FILE_PATH, file_data, sizeof(header) + key_blob_len);
}

/*
 * Load and validate a private key blob from LittleFS.
 * Returns standard negative errno values on file/format errors.
 */
static int read_key_blob_from_file(uint8_t *key_blob, size_t key_blob_size, size_t *key_blob_len)
{
	uint8_t file_data[sizeof(struct key_file_header) + KEY_BLOB_MAX_SIZE];
	struct key_file_header header;
	size_t file_len;
	int ret;

	if (key_blob_size < KEY_BLOB_MAX_SIZE) {
		return -EINVAL;
	}

	ret = lfs_key_store_read(KEY_FILE_PATH, file_data, sizeof(file_data), &file_len);
	if (ret < 0) {
		return ret;
	}

	if (file_len < sizeof(header)) {
		return -EIO;
	}

	(void)memcpy(&header, file_data, sizeof(header));

	if (header.magic != KEY_FILE_MAGIC ||
	    header.key_blob_len == 0U ||
	    header.key_blob_len > KEY_BLOB_MAX_SIZE ||
	    file_len != sizeof(header) + header.key_blob_len) {
		return -EINVAL;
	}

	(void)memcpy(key_blob, file_data + sizeof(header), header.key_blob_len);
	*key_blob_len = header.key_blob_len;
	return 0;
}

/*
 * Import a previously saved private key into PSA as a volatile key handle.
 * This is used at startup so the key can be used by crypto APIs immediately.
 */
static psa_status_t import_saved_key(psa_key_id_t *key_id)
{
	psa_status_t status;
	psa_key_attributes_t key_attributes = PSA_KEY_ATTRIBUTES_INIT;
	uint8_t key_blob[KEY_BLOB_MAX_SIZE];
	size_t key_blob_len = 0;
	int ret;

	ret = read_key_blob_from_file(key_blob, sizeof(key_blob), &key_blob_len);
	if (ret == -ENOENT || ret == -EINVAL || ret == -EIO || ret == -EFBIG) {
		if (ret != -ENOENT) {
			printk("Stored key file invalid (%d), regenerating key\n", ret);
		}
		return PSA_ERROR_DOES_NOT_EXIST;
	}

	if (ret < 0) {
		printk("Failed reading key file (%d)\n", ret);
		return PSA_ERROR_GENERIC_ERROR;
	}

	psa_set_key_usage_flags(&key_attributes,
				PSA_KEY_USAGE_ENCRYPT |
				PSA_KEY_USAGE_DECRYPT |
				PSA_KEY_USAGE_EXPORT);
	psa_set_key_algorithm(&key_attributes, PSA_ALG_RSA_PKCS1V15_CRYPT);
	psa_set_key_type(&key_attributes, PSA_KEY_TYPE_RSA_KEY_PAIR);
	psa_set_key_bits(&key_attributes, RSA_KEY_SIZE_BITS);

	status = psa_import_key(&key_attributes, key_blob, key_blob_len, key_id);
	psa_reset_key_attributes(&key_attributes);
	(void)memset(key_blob, 0, sizeof(key_blob));

	if (status == PSA_ERROR_INVALID_ARGUMENT) {
		/*
		 * Stored key blob is valid file data, but not compatible with current
		 * key attributes (for example after changing RSA key size).
		 */
		return PSA_ERROR_DOES_NOT_EXIST;
	}

	return status;
}

/*
 * One-time generation path:
 * 1) generate RSA key pair,
 * 2) export private key blob,
 * 3) save it to LittleFS,
 * 4) re-import as a runtime key handle.
 */
static psa_status_t generate_and_store_key(psa_key_id_t *key_id)
{
	psa_status_t status;
	psa_key_attributes_t gen_attributes = PSA_KEY_ATTRIBUTES_INIT;
	psa_key_attributes_t import_attributes = PSA_KEY_ATTRIBUTES_INIT;
	psa_key_id_t generated_key_id = PSA_KEY_ID_NULL;
	uint8_t key_blob[KEY_BLOB_MAX_SIZE];
	size_t key_blob_len = 0;
	int ret;

	psa_set_key_usage_flags(&gen_attributes,
				PSA_KEY_USAGE_ENCRYPT |
				PSA_KEY_USAGE_DECRYPT |
				PSA_KEY_USAGE_EXPORT);
	psa_set_key_algorithm(&gen_attributes, PSA_ALG_RSA_PKCS1V15_CRYPT);
	psa_set_key_type(&gen_attributes, PSA_KEY_TYPE_RSA_KEY_PAIR);
	psa_set_key_bits(&gen_attributes, RSA_KEY_SIZE_BITS);

	status = psa_generate_key(&gen_attributes, &generated_key_id);
	psa_reset_key_attributes(&gen_attributes);
	if (status != PSA_SUCCESS) {
		(void)memset(key_blob, 0, sizeof(key_blob));
		return status;
	}

	status = psa_export_key(generated_key_id, key_blob, sizeof(key_blob), &key_blob_len);
	if (status != PSA_SUCCESS) {
		(void)psa_destroy_key(generated_key_id);
		(void)memset(key_blob, 0, sizeof(key_blob));
		return status;
	}

	ret = write_key_blob_to_file(key_blob, key_blob_len);
	if (ret < 0) {
		(void)psa_destroy_key(generated_key_id);
		(void)memset(key_blob, 0, sizeof(key_blob));
		printk("Failed writing key file (%d)\n", ret);
		return PSA_ERROR_GENERIC_ERROR;
	}

	(void)psa_destroy_key(generated_key_id);

	psa_set_key_usage_flags(&import_attributes,
				PSA_KEY_USAGE_ENCRYPT |
				PSA_KEY_USAGE_DECRYPT |
				PSA_KEY_USAGE_EXPORT);
	psa_set_key_algorithm(&import_attributes, PSA_ALG_RSA_PKCS1V15_CRYPT);
	psa_set_key_type(&import_attributes, PSA_KEY_TYPE_RSA_KEY_PAIR);
	psa_set_key_bits(&import_attributes, RSA_KEY_SIZE_BITS);

	status = psa_import_key(&import_attributes, key_blob, key_blob_len, key_id);
	psa_reset_key_attributes(&import_attributes);
	(void)memset(key_blob, 0, sizeof(key_blob));

	return status;
}

/*
 * Public entry point used by main flow:
 * - load key from storage if present,
 * - otherwise generate and persist it.
 */
psa_status_t rsa_key_manager_load_or_generate(psa_key_id_t *key_id)
{
	psa_status_t status;

	status = import_saved_key(key_id);
	if (status == PSA_SUCCESS) {
		printk("Loaded RSA key pair from %s\n", KEY_FILE_PATH);
		return PSA_SUCCESS;
	}

	if (status != PSA_ERROR_DOES_NOT_EXIST) {
		printk("import_saved_key failed: %d (%s)\n", status, rsa_key_manager_status_string(status));
		return status;
	}

	printk("No saved key found. Generating new RSA key pair...\n");
	status = generate_and_store_key(key_id);
	if (status != PSA_SUCCESS) {
		return status;
	}

	printk("Generated and stored RSA key pair at %s\n", KEY_FILE_PATH);
	return PSA_SUCCESS;
}

/* Encrypt with the managed RSA key (PKCS#1 v1.5). */
psa_status_t rsa_key_manager_encrypt(psa_key_id_t key_id,
				     const uint8_t *plaintext,
				     size_t plaintext_len,
				     uint8_t *ciphertext,
				     size_t ciphertext_size,
				     size_t *ciphertext_len)
{
	return psa_asymmetric_encrypt(key_id,
				     PSA_ALG_RSA_PKCS1V15_CRYPT,
				     plaintext,
				     plaintext_len,
				     NULL,
				     0,
				     ciphertext,
				     ciphertext_size,
				     ciphertext_len);
}

/* Decrypt with the managed RSA key (PKCS#1 v1.5). */
psa_status_t rsa_key_manager_decrypt(psa_key_id_t key_id,
				     const uint8_t *ciphertext,
				     size_t ciphertext_len,
				     uint8_t *plaintext,
				     size_t plaintext_size,
				     size_t *plaintext_len)
{
	return psa_asymmetric_decrypt(key_id,
				     PSA_ALG_RSA_PKCS1V15_CRYPT,
				     ciphertext,
				     ciphertext_len,
				     NULL,
				     0,
				     plaintext,
				     plaintext_size,
				     plaintext_len);
}

/* Export DER-encoded RSA public key from the current key handle. */
psa_status_t rsa_key_manager_export_public_key(psa_key_id_t key_id,
					       uint8_t *public_key,
					       size_t public_key_size,
					       size_t *public_key_len)
{
	return psa_export_public_key(key_id, public_key, public_key_size, public_key_len);
}
```

## src/rsa_key_manager.h
```c
#ifndef RSA_KEY_MANAGER_H
#define RSA_KEY_MANAGER_H

#include <stddef.h>
#include <stdint.h>

#include <zephyr/autoconf.h>
#include <psa/crypto.h>

/* Derive RSA key size from enabled PSA Kconfig option. */
#define RSA_KEY_SIZE_1024_ENABLED \
	(defined(CONFIG_PSA_WANT_RSA_KEY_SIZE_1024) && CONFIG_PSA_WANT_RSA_KEY_SIZE_1024)
#define RSA_KEY_SIZE_2048_ENABLED \
	(defined(CONFIG_PSA_WANT_RSA_KEY_SIZE_2048) && CONFIG_PSA_WANT_RSA_KEY_SIZE_2048)

#if RSA_KEY_SIZE_1024_ENABLED && RSA_KEY_SIZE_2048_ENABLED
#error "Enable only one RSA key size: 1024 or 2048"
#elif RSA_KEY_SIZE_1024_ENABLED
#define RSA_KEY_SIZE_BITS 1024
#elif RSA_KEY_SIZE_2048_ENABLED
#define RSA_KEY_SIZE_BITS 2048
#else
#error "Enable CONFIG_PSA_WANT_RSA_KEY_SIZE_1024=y or CONFIG_PSA_WANT_RSA_KEY_SIZE_2048=y"
#endif

#undef RSA_KEY_SIZE_1024_ENABLED
#undef RSA_KEY_SIZE_2048_ENABLED

/* Convert PSA status to readable constant string. */
const char *rsa_key_manager_status_string(psa_status_t status);

/* Load persisted RSA key or generate/store one if missing. */
psa_status_t rsa_key_manager_load_or_generate(psa_key_id_t *key_id);

/* Encrypt plaintext using managed RSA key (PKCS#1 v1.5). */
psa_status_t rsa_key_manager_encrypt(psa_key_id_t key_id,
				     const uint8_t *plaintext,
				     size_t plaintext_len,
				     uint8_t *ciphertext,
				     size_t ciphertext_size,
				     size_t *ciphertext_len);

/* Decrypt ciphertext using managed RSA key (PKCS#1 v1.5). */
psa_status_t rsa_key_manager_decrypt(psa_key_id_t key_id,
				     const uint8_t *ciphertext,
				     size_t ciphertext_len,
				     uint8_t *plaintext,
				     size_t plaintext_size,
				     size_t *plaintext_len);

/* Export DER-encoded public key from the current key handle. */
psa_status_t rsa_key_manager_export_public_key(psa_key_id_t key_id,
					       uint8_t *public_key,
					       size_t public_key_size,
					       size_t *public_key_len);

#endif
```
